## config/boards/shields/touchpad/Kconfig.defconfig
```kconfig
if SHIELD_TOUCHPAD

config ZMK_KEYBOARD_NAME
    default "Touchpad Deck"

config ZMK_MOUSE
    default y

config ZMK_INPUT_MOUSE_PS2
    default y




endif
```
